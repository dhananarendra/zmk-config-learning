/ {
    chosen {
        zmk,kscan = &kscan0;
        zmk,matrix_transform = &matrix_transform0;
    };

    kscan0: kscan0 {
        compatible = "zmk,kscan-gpio-matrix";
        diode-direction = "col2row";

        row-gpios = 
            &gpio0 2 GPIO_ACTIVE_LOW
            &gpio0 3 GPIO_ACTIVE_LOW
        >;

        col-gpios = 
            &gpio0 5 GPIO_ACTIVE_LOW
            &gpio0 6 GPIO_ACTIVE_LOW
        >;
    };

    matrix_transform0: matrix_transform {
        compatible = "zmk,matrix-transform";
        rows = <2>;
        columns = <2>;

        map = 
            0 1
            2 3
        >;
    };
};